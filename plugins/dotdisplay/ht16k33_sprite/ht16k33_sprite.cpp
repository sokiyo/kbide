#include <stdio.h>
#include <string.h>
#include "esp_system.h"
#include "kidbright32.h"
#include "ht16k33_sprite.h"

#define HT16K33_OSC_OFF					0x20
#define HT16K33_OSC_ON					0x21
#define HT16K33_DISP_OFF				0x80
#define HT16K33_DISP_ON					0x81
#define HT16K33_DIM_SET_8_16			0xe7
#define HT16K33_DIM_SET_16_16			0xef
#define HT16K33_DISP_ADDR_PTR			0x00

#define HT16K33_SHOW_FLAG				0x01
#define HT16K33_SCROLLING_INIT_FLAG		0x02
#define HT16K33_SCROLLING_FLAG			0x04
#define HT16K33_SCROLLING_SHOW_FLAG		0x08
#define HT16K33_2CHARS_FLAG				0x10
#define HT16K33_BUSY_FLAG				0x20

const unsigned char font_6_8_sprite[] = {
	0x00, 0x00, 0x00, 0x00, 0x00, 0x00,  // 0x00
	0x00, 0x7c, 0xa2, 0x8a, 0xa2, 0x7c,  // 0x01
	0x00, 0x7c, 0xd6, 0xf6, 0xd6, 0x7c,  // 0x02
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	0x00, 0x00, 0x00, 0x00, 0x00, 0x00  // 0xff
};

// ht16k33 address convert table
static const uint32_t ht16k33_ptr_conv_sprite[] = {
	0, 2, 4, 6, 8, 10, 12, 14,
	1, 3, 5, 7, 9, 11, 13, 15
};

uint8_t cmd_init_sprite[] = {
	HT16K33_OSC_ON,
	HT16K33_DIM_SET_8_16,
	HT16K33_DISP_ON
};

uint8_t clrscr_buf_sprite[] = {
	HT16K33_DISP_ADDR_PTR,
	0x00, 0x00, 0x00, 0x00, 0x00, 0x00, 0x00, 0x00,
	0x00, 0x00, 0x00, 0x00, 0x00, 0x00, 0x00, 0x00
};

HT16K33_SPRITE::HT16K33_SPRITE(int bus_ch, int dev_addr) {
	channel = bus_ch;
	address = dev_addr;
}

void HT16K33_SPRITE::init(void) {
	flag = 0;
	set_flag = 0;
	clr_flag = 0;
	state = s_detect;
}

int HT16K33_SPRITE::prop_count(void) {
	// not supported
	return 0;
}

bool HT16K33_SPRITE::prop_name(int index, char *name) {
	// not supported
	return false;
}

bool HT16K33_SPRITE::prop_unit(int index, char *unit) {
	// not supported
	return false;
}

bool HT16K33_SPRITE::prop_attr(int index, char *attr) {
	// not supported
	return false;
}

bool HT16K33_SPRITE::prop_read(int index, char *value) {
	// not supported
	return false;
}

bool HT16K33_SPRITE::prop_write(int index, char *value) {
	// not supported
	return false;
}

int HT16K33_SPRITE::busy(void) {
	return (IS_FLAG_SET(flag, HT16K33_BUSY_FLAG));
}

int HT16K33_SPRITE::idle(void) {
	return ((IS_FLAG_SET(flag, HT16K33_BUSY_FLAG)) == 0);
}

void HT16K33_SPRITE::wait_idle(void) {
	while (!idle()) {
		vTaskDelay(50 / portTICK_RATE_MS);
    }
}

void HT16K33_SPRITE::process(Driver *drv) {
	I2CDev *i2c = (I2CDev *)drv;
	uint8_t i, strip_cnt, strip_index;
	uint8_t tmp_buf[17];
	char *ch_ptr;

	switch (state) {
		case s_detect:
			// detect i2c device
	        if (i2c->detect(channel, address) == ESP_OK) {
				// clear error flag
				error = false;
				state = s_clrscr;
			}
			else {
				state = s_error;
			}
			break;

		case s_clrscr:
			if (i2c->write(channel, address, clrscr_buf_sprite, sizeof(clrscr_buf_sprite)) == ESP_OK) {
				cmd_index = 0;
				state = s_cmd_init;
			}
			else {
				state = s_error;
			}
			break;

		case s_cmd_init:
			if (i2c->write(channel, address, &cmd_init_sprite[cmd_index], 1) == ESP_OK) {
				cmd_index++;
				if (cmd_index >= sizeof(cmd_init_sprite)) {
					// set initialized flag
					initialized = true;
					state = s_idle;
				}
			}
			else {
				state = s_error;
			}
			break;

		case s_show:
			// prepare temp buf
			tmp_buf[0] = HT16K33_DISP_ADDR_PTR;
			memcpy(&tmp_buf[1], buffer, sizeof(buffer));
			// i2c transfer
			if (i2c->write(channel, address, tmp_buf, sizeof(tmp_buf)) == ESP_OK) {
				state = s_idle;
			}
			else {
				state = s_error;
			}
			break;

		case s_scrolling_init:
			// init scrolling params
			curr_char_index = 0;
			start_strip_index = 0;
			display_width = 16;	// 16x8
			font_width = 6;	// 6x8
			// check if show 2 chars
			if (IS_FLAG_SET(flag, HT16K33_2CHARS_FLAG)) {
				curr_heading_width = 4;
			}
			else {
				curr_heading_width = display_width;
			}
			state = s_scrolling;
			break;

		case s_scrolling:
			// playing with heading
			if (curr_heading_width > 0) {
				for (i=0; i<curr_heading_width; i++) {
					buffer[ht16k33_ptr_conv_sprite[i]] = 0x00;
				}
				// left strip pass to default scrolling process
				strip_cnt = curr_heading_width;
			}
			else {
				// otherwise
				strip_cnt = 0;
			}

			// start from current char and at current strip position
			ch_ptr = &scrolling_string[curr_char_index];
			// check end of string
			if (*ch_ptr != '\x0') {
				strip_index = start_strip_index;
				// draw strip up to display width
				while ((strip_cnt < display_width) && (*ch_ptr != '\x0')) {
					for (i=strip_index; i<font_width; i++) {
						buffer[ht16k33_ptr_conv_sprite[strip_cnt]] = font_6_8_sprite[((*ch_ptr) * 6) + i] & 0xff;
						strip_cnt++;
						if (!(strip_cnt < display_width)) {
							break;
						}
					}
					ch_ptr++;
					strip_index = 0;
				}

				// clear tail area
				for (i=strip_cnt; i<display_width; i++) {
					buffer[ht16k33_ptr_conv_sprite[i]] = 0x00;
				}

				// if just playing with heading
				if (curr_heading_width > 0) {
					curr_heading_width--;
				}
				else {
					start_strip_index++;
					if (start_strip_index >= font_width) {
						start_strip_index = 0;
						curr_char_index++;
					}
				}

				// check if show 2 chars
				if (IS_FLAG_SET(flag, HT16K33_2CHARS_FLAG)) {
					FLAG_CLR(flag, HT16K33_2CHARS_FLAG);
					// set show once
					FLAG_SET(flag, HT16K33_SCROLLING_SHOW_FLAG);
				}
				else {
					// set show and then scrolling flag
					FLAG_SET(flag, HT16K33_SCROLLING_SHOW_FLAG | HT16K33_SCROLLING_FLAG);
				}
			}
			else {
				// clear last strip
				for (i = 0; i < display_width; i++) {
					buffer[i] = 0x00;
				}
				// set only show flag
				FLAG_SET(flag, HT16K33_SCROLLING_SHOW_FLAG);
			}

			state = s_idle;
			break;

		case s_idle:
			// check set/clr flag
			if (clr_flag & 0x7f) {
				FLAG_CLR(flag, clr_flag);
				clr_flag = 0;
			}
			if (set_flag & 0x7f) {
				FLAG_SET(flag, set_flag);
				set_flag = 0;
			}

			// check pending flag
			if (IS_FLAG_SET(flag, HT16K33_SHOW_FLAG)) {
				memcpy(buffer, temp_buffer, sizeof(buffer));
				FLAG_CLR(flag, HT16K33_SHOW_FLAG);
				state = s_show;
			}
			else
			if (IS_FLAG_SET(flag, HT16K33_SCROLLING_SHOW_FLAG)) {
				FLAG_CLR(flag, HT16K33_SCROLLING_SHOW_FLAG);
				state = s_show;
			}
			else
			if (IS_FLAG_SET(flag, HT16K33_SCROLLING_INIT_FLAG)) {
				strcpy(scrolling_string, scrolling_temp_string);
				FLAG_CLR(flag, HT16K33_SCROLLING_INIT_FLAG);
				state = s_scrolling_init;
			}
			else
			if (IS_FLAG_SET(flag, HT16K33_SCROLLING_FLAG)) {
				FLAG_CLR(flag, HT16K33_SCROLLING_FLAG);
				state = s_scrolling;
			}
			else
			if (IS_FLAG_SET(flag, HT16K33_BUSY_FLAG)) {
				FLAG_CLR(flag, HT16K33_BUSY_FLAG);
			}
			break;

		case s_error:
			// set error flag
			error = true;
			// clear initialized flag
			initialized = false;
			// get current tickcnt
			tickcnt = get_tickcnt();
			// goto wait and retry with detect state
			state = s_wait;
			break;

		case s_wait:
			// delay 1000ms before retry detect
			if (is_tickcnt_elapsed(tickcnt, 1000)) {
				state = s_detect;
			}
			break;
	}
}

void HT16K33_SPRITE::show(uint8_t *buf) {
	uint8_t i;

	// copy into ht16k33 buffer
	for (i = 0; i < 16; i++) {
		// convert to ht16k33 address
		temp_buffer[ht16k33_ptr_conv_sprite[i]] = buf[i];
		sprite_buffer[i] = buf[i];
	}

	clr_flag = 0x80 | HT16K33_SCROLLING_INIT_FLAG | HT16K33_SCROLLING_FLAG | HT16K33_2CHARS_FLAG | HT16K33_SCROLLING_SHOW_FLAG;
	set_flag = 0x80 | HT16K33_SHOW_FLAG;
	FLAG_SET(flag, HT16K33_BUSY_FLAG);
}

void HT16K33_SPRITE::clear(void) {
	uint8_t i;

	for (i = 0; i < 16; i++) {
		sprite_buffer[i] = 0;
	}
	show(sprite_buffer);
}

void HT16K33_SPRITE::dot(double x1, double y1, int type) {
	uint8_t i;
  uint8_t bar;
	uint8_t x = (uint8_t)x1;
	uint8_t y = (uint8_t)y1;
	if ((x < 16) && (y < 8)) {
		switch (type) {
			case 0:
				sprite_buffer[x] |= (0x01 << y);
			break;

			case 1:
				sprite_buffer[x] &= ~(0x01 << y);
			break;

			case 2:
				sprite_buffer[x] ^= (0x01 << y);
			break;

			case 3:
				bar = 0;
				for (i = 0; i <= y; ++i) {
					bar = (bar << 1) + 1;
				}
				sprite_buffer[x] |= bar;
			break;
		}
		show(sprite_buffer);
	}
}

void HT16K33_SPRITE::dot_stack(double x1, double y1, int type) {
	uint8_t i;
  uint8_t bar;
	uint8_t x = (uint8_t)x1;
	uint8_t y = (uint8_t)y1;
	if ((x < 16) && (y < 8)) {
		switch (type) {
			case 0:
				i = sprite_stack[x][y];
				if (i != LED16x8_MAX_STACK) {
					sprite_stack[x][y]++;
				}
				sprite_buffer[x] |= (0x01 << y);
			break;

			case 1:
				i = sprite_stack[x][y];
				if (i >= 2) {
					sprite_stack[x][y]--;
					sprite_buffer[x] |= (0x01 << y);
				} else {
					sprite_stack[x][y] = 0;
					sprite_buffer[x] &= ~(0x01 << y);
				}
			break;
		}
		show(sprite_buffer);
	}
}

void HT16K33_SPRITE::move(int move, int type) {
	uint8_t i;
	uint8_t temp;

	switch (type) {
		case 0:
			temp = sprite_buffer[15];
			for (i = 15; i > 0; i--) {
				sprite_buffer[i] = sprite_buffer[i-1];
			}
			if (move == 0)
				sprite_buffer[0] = temp;
			else
				sprite_buffer[0] = 0x00;
		break;

		case 1:
			temp = sprite_buffer[0];
			for (i = 0; i < 15; i++) {
				sprite_buffer[i] = sprite_buffer[i+1];
			}
			if (move == 0)
				sprite_buffer[15] = temp;
			else
				sprite_buffer[15] = 0x00;
		break;
	}
	for (i=0;i<16;i++) {
		printf("%x ",sprite_buffer[i]);
	}
	printf("\n");
	show(sprite_buffer);
}

void HT16K33_SPRITE::scroll(char *buf, bool scroll_flag) {
	char temp_buf[LED16x8_MAX_CHARS + 1];

	// check scroll flag
	if (scroll_flag) {
		strncpy(scrolling_temp_string, buf, SCROLLING_STRING_LEN);
		clr_flag = 0x80 | HT16K33_SHOW_FLAG | HT16K33_SCROLLING_FLAG | HT16K33_2CHARS_FLAG;
		set_flag = 0x80 | HT16K33_SCROLLING_INIT_FLAG;
	}
	else {
		// atomic buffer
		strncpy(temp_buf, buf, LED16x8_MAX_CHARS);
		// check right justify
		if (strlen(temp_buf) == 1) {
			temp_buf[2] = '\x0';
			temp_buf[1] = temp_buf[0];
			temp_buf[0] = ' ';
		}
		strncpy(scrolling_temp_string, temp_buf, LED16x8_MAX_CHARS);
		clr_flag = 0x80 | HT16K33_SHOW_FLAG | HT16K33_SCROLLING_FLAG;
		set_flag = 0x80 | HT16K33_SCROLLING_INIT_FLAG | HT16K33_2CHARS_FLAG;
	}

	FLAG_SET(flag, HT16K33_BUSY_FLAG);
}

void HT16K33_SPRITE::scroll(int val, bool scroll_flag) {
	char buf[SCROLLING_STRING_LEN + 1];

	snprintf(buf, SCROLLING_STRING_LEN, "%d", val);
	scroll(buf, scroll_flag);
}

void HT16K33_SPRITE::scroll(double val, bool scroll_flag) {
	char buf[SCROLLING_STRING_LEN + 1];
	int i;

	snprintf(buf, SCROLLING_STRING_LEN, "%f", val);
	// check ending zero
	i = strlen(buf) - 1;
	while (i >= 0) {
		if (buf[i] == '0') {
			buf[i] = '\x0';
		}
		else
		if (buf[i] == '.') {
			buf[i] = '\x0';
			break;
		}
		else {
			break; // first occurence of non-zero or dot
		}
		i--;
	}
	scroll(buf, scroll_flag);
}

void HT16K33_SPRITE::scroll(double val, bool scroll_flag, int precision) {
	char fmt[8];
	char buf[SCROLLING_STRING_LEN + 1];

	if (precision < 0) {
		strcpy(fmt, "%.0f");
	}
	else
	if (precision > 6) {
		strcpy(fmt, "%.6f");
	}
	else {
		snprintf(fmt, sizeof(fmt) - 1, "%%.%df", precision);
	}

	snprintf(buf, SCROLLING_STRING_LEN, fmt, val);
	scroll(buf, scroll_flag);
}
